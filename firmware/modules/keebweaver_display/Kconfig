## firmware/modules/keebweaver_display/Kconfig
```kconfig
menuconfig KEEBWEAVER_DISPLAY_ART
    bool "KeebWeaver USB display artwork"
    default y if SHIELD_NICE_VIEW
    depends on ZMK_DISPLAY
    select FLASH_MAP
    select SERIAL
    select UART_LINE_CTRL
    select USB_DEVICE_STACK
    select USB_CDC_ACM
    select LV_FONT_MONTSERRAT_14
    select LV_USE_IMG
    select LV_USE_LABEL
    help
      Store one validated 160x68 one-bit artwork image per keyboard half in
      a dedicated flash partition. The image is updated through a separate
      USB CDC endpoint and never occupies ZMK settings or Bluetooth storage.

if KEEBWEAVER_DISPLAY_ART

config KEEBWEAVER_DISPLAY_ART_USB_STACK_SIZE
    int "USB artwork receiver stack size"
    default 1024
    range 768 2048

endif

config KEEBWEAVER_LAYER_STATE_BLE
    bool "KeebWeaver BLE layer-state helper"
    default n
    depends on BT
    depends on ZMK_SPLIT_ROLE_CENTRAL
    help
      Expose the currently selected ZMK layer and pointer speed through an
      encrypted GATT service for the KeebWeaver macOS overlay. Link
      encryption does not provide application-level device identity. The
      overlay may write only the bounded pointer-speed setting. The value is
      persisted by the runtime pointer-speed module when settings are enabled.

config KEEBWEAVER_POINTER_SPEED
    bool "KeebWeaver runtime pointer speed"
    default y
    depends on ZMK_POINTING
    help
      Scale relative pointer movement at runtime without changing the
      firmware image. The setting is restored from persistent ZMK settings
      after a reboot when the settings subsystem is enabled.

if KEEBWEAVER_POINTER_SPEED && SETTINGS

config KEEBWEAVER_POINTER_SPEED_SAVE_DEBOUNCE_MS
    int "Milliseconds to debounce pointer-speed settings saves"
    default 5000
    range 1000 60000
    help
      Delay writes after a pointer-speed change so repeated adjustments do not
      wear the settings storage. The latest value is persisted after the
      adjustment settles.

endif
```

## firmware/modules/keebweaver_display/dts/bindings/behaviors/keebweaver,behavior-pointer-speed.yaml
```yaml
# SPDX-License-Identifier: MIT

description: KeebWeaver runtime pointer-speed adjustment behavior

compatible: "keebweaver,behavior-pointer-speed"

include: one_param.yaml
```

## firmware/modules/keebweaver_display/dts/bindings/input_processors/keebweaver,input-processor-pointer-speed.yaml
```yaml
# SPDX-License-Identifier: MIT

description: Input processor for the KeebWeaver runtime pointer-speed setting

compatible: "keebweaver,input-processor-pointer-speed"

include: ip_zero_param.yaml

properties:
  type:
    type: int
    required: true
  codes:
    type: array
    required: true
```
